## conf/layer.conf
```bitbake
# We have a conf and classes directory, add to BBPATH
BBPATH .= ":${LAYERDIR}"

# We have recipes-* directories, add to BBFILES
BBFILES += "${LAYERDIR}/recipes-*/*/*.bb \
            ${LAYERDIR}/recipes-*/*/*.bbappend"

BBFILE_COLLECTIONS += "meta-naveed"
BBFILE_PATTERN_meta-naveed = "^${LAYERDIR}/"
BBFILE_PRIORITY_meta-naveed = "6"

LAYERDEPENDS_meta-naveed = "core"
LAYERSERIES_COMPAT_meta-naveed = "kirkstone"
```

## recipes-core/images/files/naveed-ls1046a.wks
```
bootloader --ptable gpt

part /boot     --source bootimg-partition --fstype=vfat --label boot --size 64

part /         --source rootfs            --fstype=ext4 --label rootfsA --size 900

part           --source rootfs            --fstype=ext4 --label rootfsB --size 900

part /data     --fstype=ext4              --label data --size 128
```

## wic/naveed-ls1046a.wks
```
bootloader --ptable gpt

# 1) Boot (~64 MiB, FAT)
part /boot --source bootimg-partition \
     --fstype=vfat --label boot --size=64M

# 2) Rootfs A (~900 MiB)
part / --source rootfs \
     --fstype=ext4 --label rootfsA --size=900M

# 3) Rootfs B (~900 MiB)
part /rootfsB --source rootfs \
     --fstype=ext4 --label rootfsB --size=900M

# 4) Data (~128 MiB)
part /data --fstype=ext4 --label data --size=128M
```
